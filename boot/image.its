## boot/image.its
```
/dts-v1/;

/ {
	timestamp = <0x6298fb03>;
	description = "CPRELEASE COCONUT IBR600C 7.22.60";
	#address-cells = <0x01>;

	images {

		kernel@1 {
			data = /incbin/("kernel.gz");
			type = "kernel";
			arch = "arm";
			os = "linux";
			compression = "gzip";
			load = <0x80208000>;
			entry = <0x80208000>;

			hash@1 {
				algo = "crc32";
			};

			hash@2 {
				algo = "sha1";
			};
		};

		fdt@1 {
			description = "IBR600C device tree blob";
			data = /incbin/("dt.dtb");
			type = "flat_dt";
			arch = "arm";
			compression = "none";

			hash@1 {
				algo = "crc32";
			};

			hash@2 {
				algo = "sha1";
			};
		};
	};

	configurations {
		default = "config@5";

		config@5 {
			description = "Coconut";
			kernel = "kernel@1";
			fdt = "fdt@1";
		};
	};
};
```

## openwrt/image.its
```
/dts-v1/;

/ {
	timestamp = <0x634c8874>;
	description = "ARM OpenWrt FIT (Flattened Image Tree)";
	#address-cells = <0x01>;

	images {

		kernel-1 {
			description = "ARM OpenWrt Linux-5.15.72";
			data = /incbin/("kernel.lzma");
			type = "kernel";
			arch = "arm";
			os = "linux";
			compression = "lzma";
			load = <0x80208000>;
			entry = <0x80208000>;

			hash@1 {
				algo = "crc32";
			};

			hash@2 {
				algo = "sha1";
			};
		};

		fdt-1 {
			description = "ARM OpenWrt device tree blob";
			data = /incbin/("dt.dtb");
			type = "flat_dt";
			arch = "arm";
			compression = "none";

			hash@1 {
				algo = "crc32";
			};

			hash@2 {
				algo = "sha1";
			};
		};
	};

	configurations {
		default = "config@1";

		config@1 {
			description = "OpenWrt 8dev_jalapeno";
			kernel = "kernel-1";
			fdt = "fdt-1";
		};
	};
};
```
